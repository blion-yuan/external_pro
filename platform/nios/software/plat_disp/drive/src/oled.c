/*
 * oled.c
 *
 *  Created on: 2022-4-10
 *      Author: blion
 */

#include "i2c.h"
#include "sys_timer.h"

const alt_u8 F8X16[]=
{
  0x00,0x00,0x00,0x00,0x00,0x00,0x00,0x00,0x00,0x00,0x00,0x00,0x00,0x00,0x00,0x00,// 0
  0x00,0x00,0x00,0xF8,0x00,0x00,0x00,0x00,0x00,0x00,0x00,0x33,0x30,0x00,0x00,0x00,//! 1
  0x00,0x10,0x0C,0x06,0x10,0x0C,0x06,0x00,0x00,0x00,0x00,0x00,0x00,0x00,0x00,0x00,//" 2
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    0x10,0x08,0x08,0x08,0xC8,0x38,0x08,0x00,0x20,0x38,0x26,0x21,0x20,0x20,0x18,0x00,//Z 58
};


void oled_wr_data(alt_u8 send_data)
{
	i2c_star();
	i2c_send_byte(0x78);
	i2c_send_byte(0x40);			//write data
	i2c_send_byte(send_data);
	i2c_stop();
}

void oled_wr_cmd(alt_u8 send_cmd)
{
	i2c_star();
	i2c_send_byte(0x78);
	i2c_send_byte(0x00);			//write data
	i2c_send_byte(send_cmd);
	i2c_stop();
}

void oled_set_point(alt_u8 x, alt_u8 y)
{
	oled_wr_cmd(0xb0+y);
	oled_wr_cmd(((x&0xf0)>>4)|0x10);
	oled_wr_cmd((x&0x0f)|0x01);
}

void oled_fill(alt_u8 bmp_dat)
{
	unsigned char y,x;
	for(y=0;y<8;y++)
	{
		oled_wr_cmd(0xb0+y);
		oled_wr_cmd(0x01);
		oled_wr_cmd(0x10);
		for(x=0;x<128;x++)
		{
			oled_wr_data(bmp_dat);
		}
	}
}

void oled_clr(void)
{
	unsigned char y,x;
	for(y=0;y<8;y++)
	{
		oled_wr_cmd(0xb0+y);
		oled_wr_cmd(0x01);
		oled_wr_cmd(0x10);
		for(x=0;x<128;x++)
		{
			oled_wr_data(0);
		}
	}
}

void oled_init(void)
{
	delay_ms(500);//初始化之前的延时很重要！
	oled_wr_cmd(0xae);//--turn off oled panel
	oled_wr_cmd(0x00);//---set low column address
	oled_wr_cmd(0x10);//---set high column address
	oled_wr_cmd(0x40);//--set start line address  Set Mapping RAM Display Start Line (0x00~0x3F)
	oled_wr_cmd(0x81);//--set contrast control register
	oled_wr_cmd(0xff); // Set SEG Output Current Brightness
	oled_wr_cmd(0xa1);//--Set SEG/Column Mapping     0xa0左右反置 0xa1正常
	oled_wr_cmd(0xc8);//Set COM/Row Scan Direction   0xc0上下反置 0xc8正常
	oled_wr_cmd(0xa6);//--set normal display
	oled_wr_cmd(0xa8);//--set multiplex ratio(1 to 64)
	oled_wr_cmd(0x3f);//--1/64 duty
	oled_wr_cmd(0xd3);//-set display offset	Shift Mapping RAM Counter (0x00~0x3F)
	oled_wr_cmd(0x00);//-not offset
	oled_wr_cmd(0xd5);//--set display clock divide ratio/oscillator frequency
	oled_wr_cmd(0x80);//--set divide ratio, Set Clock as 100 Frames/Sec
	oled_wr_cmd(0xd9);//--set pre-charge period
	oled_wr_cmd(0xf1);//Set Pre-Charge as 15 Clocks & Discharge as 1 Clock
	oled_wr_cmd(0xda);//--set com pins hardware configuration
	oled_wr_cmd(0x12);
	oled_wr_cmd(0xdb);//--set vcomh
	oled_wr_cmd(0x40);//Set VCOM Deselect Level
	oled_wr_cmd(0x20);//-Set Page Addressing Mode (0x00/0x01/0x02)
	oled_wr_cmd(0x02);//
	oled_wr_cmd(0x8d);//--set Charge Pump enable/disable
	oled_wr_cmd(0x14);//--set(0x10) disable
	oled_wr_cmd(0xa4);// Disable Entire Display On (0xa4/0xa5)
	oled_wr_cmd(0xa6);// Disable Inverse Display On (0xa6/a7)
	oled_wr_cmd(0xaf);//--turn on oled panel
	oled_fill(0x00); //初始清屏
	oled_set_point(0,0);
}

/*******************功能描述：显示8*16一组标准ASCII字符串	 显示的坐标（x,y），y为页范围0～7****************/
void oled_show_string16(alt_u8 x, alt_u8 y,char ch[])
{
	alt_u8 c=0,i=0,j=0;
	while (ch[j]!='\0')
	{
		c =ch[j]-32;
		if(x>120)
		{
			x=0;y++;
		}
		oled_set_point(x,y);
		for(i=0;i<8;i++)
		{
			oled_wr_data(F8X16[c*16+i]);
		}
		oled_set_point(x,y+1);
		for(i=0;i<8;i++)
		{
			oled_wr_data(F8X16[c*16+i+8]);
		}

		x+=8;
		j++;
	}
}

void data_show(alt_u8 x,alt_u8 y,alt_u8 num)
{
	alt_u8 i;
	if(x>120)
	{
		x=0;y++;
	}
	oled_set_point(x,y);
	for(i=0;i<8;i++)
	{
		oled_wr_data(F8X16[num*16+i]);
	}
	oled_set_point(x,y+1);
	for(i=0;i<8;i++)
	{
		oled_wr_data(F8X16[num*16+i+8]);
	}
}
void oled_show_num16(alt_u8 x, alt_u8 y,alt_u8 data_num)
{
	alt_u8 c=0;
	alt_u8 bai,rem_bai,shi,ge;

	bai = data_num / 100;
	rem_bai = data_num % 100;
	shi = rem_bai / 10;
	ge  = rem_bai % 10;
	if(bai >0)
	{
		c= bai + 16;
		data_show(x,y,c);
		x+=8;
	}
	if(shi >0)
	{
		c= shi + 16;
		data_show(x,y,c);
		x+=8;

	}
	if(ge >=0)
	{
		c= ge + 16;
		data_show(x,y,c);
		x+=8;

	}
}

